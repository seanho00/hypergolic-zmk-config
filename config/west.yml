## config/west.yml
```yaml
# https://docs.zephyrproject.org/latest/develop/west/manifest.html
# zmkfirmware:main
# urob:mouse-3.2
# ftc:mouse-ftc
# petejohanson:feat/pointers-move-scroll (PR 2027)
---
manifest:
  projects:
    - name: zmk
      url: https://github.com/petejohanson/zmk
      revision: feat/pointers-move-scroll
      import: app/west.yml
      clone-depth: 1
  self:
    path: config
```
